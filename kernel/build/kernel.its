## kernel/build/kernel.its
```
/dts-v1/;
/ {
    description = "U-boot FIT Image for Orange Pi RV2";
    #address-cells = <2>;
    images {
        kernel {
            description = "Kernel Image";
            data = /incbin/("kernel.bin");
            type = "kernel";
            arch = "riscv";
            os = "linux";
            compression = "none";
            load = <0x0 0x00200000>;
            entry = <0x0 0x00200000>;
        };
        fdt {
            description = "Flat Device Tree";
            data = /incbin/("x1_orangepi-rv2.dtb");
            type = "flat_dt";
            arch = "riscv";
            compression = "none";
            load = <0x0 0x31000000>;
        };
        ramdisk {
             description = "Initial Ramdisk";
             data = /incbin/("initramfs.cpio");
             type = "ramdisk";
             arch = "riscv";
             os = "linux";
             compression = "none";
             load = <0x0 0x46100000>;
         };
    };
    configurations {
         default = "conf";
         conf {
             kernel = "kernel";
             fdt = "fdt";
             ramdisk = "ramdisk";
         };
    };
};
```
